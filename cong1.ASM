ORG 0000H
LJMP MAIN 
ORG 0100H
		
RS BIT P3.5
RW BIT P3.6 
E  BIT P3.7		             

MAIN:   ACALL LCDINI
		MOV R7, #57H
		ACALL BSTART
		ACALL CHAR
		ACALL LCESHOW1
		ACALL LCESHOW2

LL:		MOV R7, #01H
		ACALL BSTART
		MOV P1, 40H
		SJMP LL

BSTART: CLR EA
		MOV TMOD, #20H
		MOV TH1, #0F4H
		MOV TL1, #0F4H
		MOV PCON, #00H
		SETB TR1
		MOV SCON, #50H

BLOOP1: JNB RI, $
		CLR RI
		MOV A, SBUF
		XRL A, #0E1H
		JNZ BLOOP1
		MOV SBUF, #0E2H
		JNB TI, $
		CLR TI
		MOV R0, #40H
		MOV R1, #00H

BLOOP2: JNB RI, $
		CLR RI
		MOV A, SBUF
		MOV @R0, A
		INC R0
		ADD A, R1
		MOV R1, A
		DJNZ R7, BLOOP2
		JNB RI, $
		CLR RI
		MOV A, SBUF
		XRL A, R1
		JZ END1
		MOV SBUF, #0FFH
		JNB TI, $
		CLR TI
		SJMP BLOOP1

END1:   MOV SBUF, #00H
		RET

LCD: 	ACALL LCDINI 
	 	ACALL CHAR 
		ACALL LCESHOW1
		ACALL LCESHOW2 
		RET

LCDINI: MOV P0, #01H
		ACALL ENABLE 
		MOV P0, #38H 
		ACALL ENABLE 
		MOV P0, #0FH 
		ACALL ENABLE 
		RET

ENABLE: CLR RS
		CLR RW 
		CLR E 
		ACALL DELAY 
		SETB E 
		RET

WRITE:	MOV R7, #00H
L2:		MOV A, R7 
		MOVC A, @A+DPTR 
		ACALL WRITENABLE 
		INC R7
		CJNE R7, #39H, L2 
		RET

WRITE2:	MOV R7, #00H
L22:	MOV A, R7
		MOVC A, @A+DPTR
		ACALL WRITENABLE
		INC R7
		CJNE R7, #10H, L22
		RET

WRITE40CHAR:
		MOV R7, #00H
		MOV R1, #40H
F1:	    MOV A, @R1
		ACALL WRITENABLE
		INC R7
		INC R1
		CJNE R7, #38H, F1
		RET

WRITEL: MOV R7, #00H
		MOV R1, #78H
F2:	    MOV A, @R1
		ACALL WRITENABLE
		INC R7
		INC R1
		CJNE R7, #0FH, F2
		RET

WRITEL2:MOV R7, #00H
		MOV R1, #87H
F3:	    MOV A, @R1
		ACALL WRITENABLE
		INC R7
		INC R1
		CJNE R7, #10H, F3
		RET

WRITENABLE: 
		MOV P0,A 
		SETB RS 
		CLR RW 
		CLR E 
		ACALL DELAY 
		SETB E 
		RET

CHAR:	MOV P0,#40H 
		ACALL ENABLE 
		ACALL WRITE40CHAR 
		RET

LCESHOW1:
        MOV P0, #80H 
		ACALL ENABLE 
		ACALL WRITEL 
		RET
LCESHOW2:
		MOV P0,#0C0H 
		ACALL ENABLE 
		ACALL WRITEL2 
		RET

DELAY:	MOV R3, #20
D1:		MOV R4, #250 
		DJNZ R4, $
		DJNZ R3, D1 
		RET

END
