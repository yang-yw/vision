ORG 0000H
LJMP MAIN 
ORG 0100H		             

RS BIT P3.5 
RW BIT P3.6 
E  BIT P3.7

MAIN:	ACALL LCD
		ACALL MOVE1
		MOV R7, #57H
		ACALL START

K1:  	ACALL KEYSCAN
     	ACALL DISPDIGITAL
     	SJMP  K1

MOVE1:  MOV DPTR, #TAB1
		MOV R7, #00H
		MOV R1, #40H
F1:	    MOV A, R7
		MOVC A, @A+DPTR
		MOV @R1, A
		INC R7
		INC R1
		CJNE R7, #38H, F1

MOVE2:	MOV DPTR, #TAB2
		MOV R7, #00H
		MOV R1, #78H
F2:  	MOV A, R7
		MOVC A, @A+DPTR
		MOV @R1, A
		INC R7
		INC R1
		CJNE R7, #0FH, F2

MOVE3:	MOV DPTR, #TAB3
		MOV R7, #00H
		MOV R1, #87H
F3:  	MOV A, R7
		MOVC A, @A+DPTR
		MOV @R1, A
		INC R7
		INC R1
		CJNE R7, #10H, F3
		RET

START:  CLR EA
		MOV TMOD, #20H
		MOV TH1, #0F4H
		MOV TL1, #0F4H
		MOV PCON, #00H
		SETB TR1
		MOV SCON, #50H

LOOP1:  MOV SBUF, #0E1H
		JNB TI, $
		CLR TI
		JNB RI, $
		CLR RI
		MOV A, SBUF
		XRL A, #0E2H
		JNZ LOOP1

LOOP2:  MOV R0, #40H
		MOV R1, #00H

LOOP3:  MOV SBUF, @R0
		MOV A, R1
		ADD A, @R0
		MOV R1, A
		INC R0
		JNB TI, $
		CLR TI
		DJNZ R7, LOOP3
		MOV SBUF, R1
		JNB TI, $
		CLR TI
		JNB RI, $
		CLR RI
		MOV A, SBUF
		XRL A, #00H
		JNZ LOOP3
		RET

LCD: 	ACALL LCDINI 
	 	ACALL CHAR 
		ACALL LCESHOW1
		ACALL LCESHOW2 
		RET

KEYSCAN:MOV P1, #0F0H
		MOV A, P1
		CJNE A, #0F0H, KEY1 
		LJMP K1
KEY1:	ACALL DELAY 
		MOV A, P1
		CJNE A, #0F0H, KEY2 
		LJMP K1
KEY2:	MOV B, #0FEH
L1:		MOV P1, B
		MOV A, P1
		ANL A, #0F0H
		CJNE A, #0F0H, KEYPRO
		MOV A, B
		RL A 
		MOV B, A 
		SJMP L1
KEYPRO:	MOV B, P1
		MOV DPTR, #KEYVALUE 
		MOV R3, #0FFH
KEY3:	INC R3 
		MOV A, R3 
		MOVC A, @A+DPTR 
		CJNE A, B, KEY3 
		MOV A, R3 
		MOV 30H, A 
		ACALL DELAY
WAIT:	MOV P1, #0F0H 
		MOV A, P1
		CJNE A, #0F0H, WAIT 
		RET

DISPDIGITAL:
		MOV DPTR, #TABLE 
		MOV A, 30H 
		MOVC A, @A+DPTR 
		MOV 40H, A
		MOV R7, #01H
		MOV P2, A
		ACALL START 
		RET

LCDINI: MOV P0, #01H
		ACALL ENABLE 
		MOV P0, #38H 
		ACALL ENABLE 
		MOV P0, #0FH 
		ACALL ENABLE 
		RET

ENABLE: CLR RS
		CLR RW 
		CLR E 
		ACALL DELAY 
		SETB E 
		RET

WRITE:	MOV R7, #00H
L2:		MOV A, R7 
		MOVC A, @A+DPTR 
		ACALL WRITENABLE 
		INC R7
		CJNE R7, #39H, L2 
		RET

WRITE2:	MOV R7, #00H
L22:	MOV A, R7
		MOVC A, @A+DPTR
		ACALL WRITENABLE
		INC R7
		CJNE R7, #10H, L22
		RET

WRITENABLE: 
		MOV P0,A 
		SETB RS 
		CLR RW 
		CLR E 
		ACALL DELAY 
		SETB E 
		RET

CHAR:	MOV P0,#40H 
		ACALL ENABLE 
		MOV DPTR, #TAB1
		ACALL WRITE 
		RET

LCESHOW1:
        ACALL DELAY
		MOV P0, #80H 
		ACALL ENABLE 
		MOV DPTR, #TAB2 
		ACALL WRITE 
		RET
LCESHOW2:
		ACALL DELAY
		MOV P0,#0C0H 
		ACALL ENABLE 
		MOV DPTR,#TAB3 
		ACALL WRITE2 
		RET			


DELAY:	MOV R3, #20
D1:		MOV R4, #250 
		DJNZ R4, $
		DJNZ R3, D1 
		RET


KEYVALUE:
DB 077H,07BH,07DH,07EH,0B7H,0BBH,0BDH,0BEH,0D7H,0DBH,0DDH,0DEH,0E7H,0EBH,0EDH,0EEH

TABLE:	  
DB 0C0H,0F9H,0A4H,0B0H,099H,092H,082H,0F8H,080H,090H,088H,083H,0C6H,0A1H,086H,08EH

TAB1:
DB 004H,01FH,015H,01FH,015H,01FH,004H,007H;��
DB 005H,00BH,01BH,009H,01FH,009H,01DH,009H;��
DB 008H,00BH,01DH,00AH,01FH,01BH,00DH,00BH;��
DB 00AH,00DH,00FH,018H,01FH,00DH,00FH,008H;��
DB 00EH,01FH,015H,00EH,004H,01FH,004H,00AH;��
DB 000H,000H,000H,000H,000H,000H,000H,000H 
DB 000H,000H,000H,000H,000H,000H,000H,000H 
TAB2:	
DB 00H,01H,"1904",02H,03H,04H,"     ",05H,06H,07H
TAB3:	
DB "8206190428 :D     ",07H,07H,07H,07H,07H,07H,07H

END
	
		

